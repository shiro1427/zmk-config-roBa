## config/west.yml
```yaml
manifest:
  remotes:
    - name: zmkfirmware
      url-base: https://github.com/zmkfirmware
    - name: sayu-hub
      url-base: https://github.com/sayu-hub
  projects:
# config/west.yml
    - name: zmk
      remote: zmkfirmware
      revision: main  # v0.3-branch から修正
      import: app/west.yml
  self:
    path: config
```
